## config/boards/shields/custom-keyboard/Kconfig.defconfig
```kconfig
if SHIELD_CUSTOM_KEYBOARD

config ZMK_KEYBOARD_NAME
    default "custom-keyboard"

endif
```

## config/boards/shields/custom-keyboard/Kconfig.shield
```kconfig
config SHIELD_CUSTOM_KEYBOARD
    def_bool $(shields_list_contains,custom-keyboard)
```

## zmk-module/drivers/kscan/Kconfig
```kconfig
config KSCAN_SR_MATRIX
	bool "Shift register matrix keyboard scan driver"
	default y
	depends on SPI && GPIO
	select KSCAN
	help
	  Enable shift register (74HC595) based keyboard matrix scanning.
	  Uses SPI to drive column shift registers and GPIO to read rows.
```

## zmk-module/dts/bindings/kscan-sr-matrix.yaml
```yaml
description: |
  Keyboard scan matrix using 74HC595 shift registers for columns
  and GPIO for rows. Uses SPI to drive shift register chain.

compatible: "groguv12,kscan-sr-matrix"

include: [kscan.yaml, spi-device.yaml]

properties:
  col-count:
    type: int
    required: true
    description: Number of columns
  row-count:
    type: int
    required: true
    description: Number of rows
  sr-bytes:
    type: int
    required: true
    description: Number of bytes in shift register chain (3 for 24 bits)
  latch-gpios:
    type: phandle-array
    required: true
    description: GPIO for shift register latch (RCLK)
  row-gpios:
    type: phandle-array
    required: true
    description: GPIO pins for matrix rows (active high with pull-down)
  poll-interval-ms:
    type: int
    default: 1
    description: Polling interval in milliseconds
  debounce-ms:
    type: int
    default: 5
    description: Debounce time in milliseconds
```

## zmk_module/drivers/gpio/Kconfig
```kconfig
config GPIO_165
	bool "74HC165 PISO shift register GPIO input driver"
	default y
	depends on SPI && GPIO
	help
	  Enable 74HC165 parallel-in serial-out shift register
	  GPIO input driver for reading matrix rows via SPI.
```

## zmk_module/drivers/input/Kconfig
```kconfig
config INPUT_ANALOG_JOYSTICK
	bool "Analog joystick input driver"
	default y
	depends on ADC && GPIO
	help
	  Enable analog joystick driver that reads ADC channels
	  for X/Y axes and generates mouse or scroll input events.
```

## zmk_module/dts/bindings/gpio/zmk,gpio-165.yaml
```yaml
description: |
  74HC165 parallel-in serial-out shift register GPIO input expander.
  Uses SPI CS pin (set to GPIO_ACTIVE_HIGH) as the PL (parallel load) control.
  Between SPI transactions PL is LOW (loading), during reads PL is HIGH (shifting).

compatible: "zmk,gpio-165"

include: [gpio-controller.yaml, spi-device.yaml]

properties:
  "#gpio-cells":
    const: 2
  ngpios:
    type: int
    required: true
    description: Number of GPIO input pins (8, 16, 24, or 32 for daisy-chained)

gpio-cells:
  - pin
  - flags
```

## zmk_module/dts/bindings/input/zmk,input-analog-joystick.yaml
```yaml
description: |
  Analog joystick input driver. Reads two ADC channels for X/Y axes
  and an optional button GPIO. Can operate in mouse or scroll mode.

compatible: "zmk,input-analog-joystick"

properties:
  io-channels:
    required: true
    description: ADC channels for X and Y axes (2 channels required)
  button-gpios:
    type: phandle-array
    description: GPIO for joystick button (active low with pull-up)
  deadzone:
    type: int
    default: 100
    description: ADC deadzone around center (values below this ignored)
  poll-interval-ms:
    type: int
    default: 10
    description: Polling interval in milliseconds
  sensitivity:
    type: int
    default: 15
    description: Movement sensitivity multiplier
  scroll-mode:
    type: boolean
    description: If set, outputs scroll events instead of mouse movement
```
